## CMakeLists.txt
```
cmake_minimum_required(VERSION 3.20.0)
find_package(Zephyr REQUIRED HINTS $ENV{ZEPHYR_BASE})

project(zephyr_nrf91_gnss)

target_include_directories(app PRIVATE include)
target_sources(app PRIVATE src/main.c src/fake_agps_data.c)
```

## Kconfig
```
menu "nrf91_gnss"

config GNSS_SINGLE_FIX
	bool "Enable single fix navigation mode"
	default n
	help
	  When enabled, GNSS is configured for a single fix (interval set to 0).
	  GNSS receiver stops once a valid PVT estimate is produced, or when the fix
	  timeout expires.

config GNSS_PERIODIC_INTERVAL
	int "Fix interval for periodic GPS fixes"
	range 10 65535
	default 120
	depends on !GNSS_SINGLE_FIX
	help
	  Fix interval (in seconds) for periodic fixes.

config GNSS_PERIODIC_TIMEOUT
	int "Fix timeout for periodic GPS fixes"
	range 0 65535
	default 480
	help
	  Fix timeout (in seconds). Set to 0 to allow GNSS to run indefinitely
	  until a valid PVT estimate is produced.

endmenu

menu "Zephyr Kernel"
source "Kconfig.zephyr"
endmenu
```

## prj.conf
```kconfig
CONFIG_LOG=y

CONFIG_NRF_MODEM_LIB=y

CONFIG_NEWLIB_LIBC=y
CONFIG_NEWLIB_LIBC_FLOAT_PRINTF=y
CONFIG_FPU=y

CONFIG_LTE_LINK_CONTROL=y
CONFIG_LTE_NETWORK_MODE_LTE_M_NBIOT_GPS=y
CONFIG_LTE_LC_NEIGHBOR_CELL_MEAS_MODULE=y

CONFIG_MAIN_STACK_SIZE=4096
CONFIG_HEAP_MEM_POOL_SIZE=4096

CONFIG_LTE_LC_EDRX_MODULE=y
CONFIG_LTE_LC_PSM_MODULE=y

# PSM periodic TAU and active time
# encoded as (timer unit * multiplier) in binary
# per 3GPP TS 24.008
CONFIG_LTE_PSM_REQ_RPTAU="00101000" # 8 Hours
CONFIG_LTE_PSM_REQ_RAT="00001000"   # 16 secs

CONFIG_NETWORKING=y
CONFIG_NET_NATIVE=n
CONFIG_NET_SOCKETS=y
CONFIG_NET_SOCKETS_OFFLOAD=y
CONFIG_POSIX_API=y

CONFIG_DATE_TIME=y
CONFIG_DATE_TIME_NTP=y

CONFIG_NRF_CLOUD=y
CONFIG_MODEM_JWT=y
CONFIG_MODEM_INFO=y
CONFIG_NRF_CLOUD_REST=y
CONFIG_NRF_CLOUD_AGNSS=y
CONFIG_MODEM_INFO_ADD_NETWORK=y
```

## src/main.c
```c
#include <zephyr/kernel.h>
#include <net/nrf_cloud_rest.h>
#include <net/nrf_cloud_agnss.h>
#include <modem/nrf_modem_lib.h>
#include <nrf_modem_gnss.h>
#include <zephyr/logging/log.h>
#include <modem/lte_lc.h>
#include <nrf_modem_at.h>
#include <date_time.h>
#include <stdint.h>

LOG_MODULE_REGISTER(nrf91_gnss);

static K_SEM_DEFINE(lte_connected, 0, 1);
static K_SEM_DEFINE(time_synced, 0, 1);
static K_SEM_DEFINE(agnss_req_ready, 0, 1);
static K_SEM_DEFINE(cell_meas_ready, 0, 1);

static struct nrf_modem_gnss_agnss_data_frame gnss_agnss_req;
static struct nrf_modem_gnss_pvt_data_frame   pvt_data;

static struct lte_lc_cells_info cell_info = {0};

static int64_t gnss_start_time;
static bool    first_fix = false;

static char jwt_buf[600];
static char rx_buf[2048];
static char agnss_data_buf[NRF_CLOUD_AGNSS_MAX_DATA_SIZE];

static void print_fix_data(struct nrf_modem_gnss_pvt_data_frame *pvt)
{
  LOG_INF("Latitude:       %.06f", pvt->latitude);
  LOG_INF("Longitude:      %.06f", pvt->longitude);
  LOG_INF("Altitude:       %.01f m", (double)pvt->altitude);
  LOG_INF("Time (UTC):     %02u:%02u:%02u.%03u", pvt->datetime.hour,
          pvt->datetime.minute, pvt->datetime.seconds, pvt->datetime.ms);
}

static void  gnss_event_handler(int evt)
{
  int err;

  switch (evt) {
  case NRF_MODEM_GNSS_EVT_AGNSS_REQ:
    err = nrf_modem_gnss_read(&gnss_agnss_req, sizeof(gnss_agnss_req),
                              NRF_MODEM_GNSS_DATA_AGNSS_REQ);
    if (err) {
      LOG_ERR("Failed to read A-GNSS request: %d", err);
      break;
    }
    LOG_INF("A-GNSS request from modem: data_flags=0x%08X",
            gnss_agnss_req.data_flags);
    k_sem_give(&agnss_req_ready);
    break;

  case NRF_MODEM_GNSS_EVT_PVT:
    err = nrf_modem_gnss_read(&pvt_data, sizeof(pvt_data),
                              NRF_MODEM_GNSS_DATA_PVT);
    if (err) {
      LOG_ERR("nrf_modem_gnss_read failed, err %d", err);
      return;
    }

    int num_satellites = 0;
    for (int i = 0; i < NRF_MODEM_GNSS_MAX_SATELLITES; i++) {
      if (pvt_data.sv[i].signal != 0) {
        LOG_INF("sv: %d, cn0: %d, signal: %d", pvt_data.sv[i].sv,
                pvt_data.sv[i].cn0, pvt_data.sv[i].signal);
        num_satellites++;
      }
    }
    LOG_INF("Searching... satellites in view: %d", num_satellites);

    if (pvt_data.flags & NRF_MODEM_GNSS_PVT_FLAG_FIX_VALID) {
      print_fix_data(&pvt_data);
      if (!first_fix) {
        LOG_INF("TTFF: %2.1lld s", (k_uptime_get() - gnss_start_time) / 1000);
        first_fix = true;
      }
    }

    if (pvt_data.flags & NRF_MODEM_GNSS_PVT_FLAG_DEADLINE_MISSED) {
      LOG_INF("GNSS Blocked by LTE activity");
    } else if (pvt_data.flags & NRF_MODEM_GNSS_PVT_FLAG_NOT_ENOUGH_WINDOW_TIME) {
      LOG_INF("Insufficient GNSS time window");
    }
    break;

  case NRF_MODEM_GNSS_EVT_PERIODIC_WAKEUP:
    LOG_INF("GNSS has woken up");
    break;

  case NRF_MODEM_GNSS_EVT_SLEEP_AFTER_FIX:
    LOG_INF("GNSS enters sleep after fix");
    break;

  default:
    break;
  }
}

static void lte_handler(const struct lte_lc_evt *const evt)
{
  switch (evt->type) {
  case LTE_LC_EVT_NW_REG_STATUS:
    if (evt->nw_reg_status != LTE_LC_NW_REG_REGISTERED_HOME &&
        evt->nw_reg_status != LTE_LC_NW_REG_REGISTERED_ROAMING) {
      break;
    }
    LOG_INF("LTE registered: %s",
            evt->nw_reg_status == LTE_LC_NW_REG_REGISTERED_HOME ? "home network"
                                                                : "roaming");
    k_sem_give(&lte_connected);
    break;

  case LTE_LC_EVT_RRC_UPDATE:
    LOG_INF("RRC mode: %s",
            evt->rrc_mode == LTE_LC_RRC_MODE_CONNECTED ? "connected" : "idle");
    break;

  case LTE_LC_EVT_PSM_UPDATE:
    LOG_INF("PSM parameter update: TAU: %d s, Active time: %d s",
            evt->psm_cfg.tau, evt->psm_cfg.active_time);
    if (evt->psm_cfg.active_time == -1) {
      LOG_ERR("Network rejected PSM parameters. Failed to enable PSM");
    }
    break;

  case LTE_LC_EVT_EDRX_UPDATE:
    LOG_INF("eDRX parameter update: eDRX: %.2f s, PTW: %.2f s",
            (double)evt->edrx_cfg.edrx, (double)evt->edrx_cfg.ptw);
    break;

  case LTE_LC_EVT_NEIGHBOR_CELL_MEAS:
    if (evt->cells_info.current_cell.id != LTE_LC_CELL_EUTRAN_ID_INVALID) {
      memcpy(&cell_info, &evt->cells_info, sizeof(cell_info));
    }
    k_sem_give(&cell_meas_ready);
    break;

  default:
    break;
  }
}

static void date_time_event_handler(const struct date_time_evt *evt)
{
  if (evt->type == DATE_TIME_OBTAINED_MODEM ||
      evt->type == DATE_TIME_OBTAINED_NTP ||
      evt->type == DATE_TIME_OBTAINED_EXT) {
    LOG_INF("Time synced (source: %d)", evt->type);
    k_sem_give(&time_synced);
  }
}

static int modem_configure(void)
{
  int err;

  LOG_INF("Initializing modem library");
  err = nrf_modem_lib_init();
  if (err) {
    LOG_ERR("Failed to initialize the modem library, error: %d", err);
    return err;
  }

  date_time_register_handler(date_time_event_handler);

  /* Request eDRX and PSM from the network
   * This can also be done automatically using
   * Kconfig (CONFIG_LTE_PSM_REQ / CONFIG_LTE_EDRX_REQ)
   */
  err = lte_lc_psm_req(true);
  if (err) {
    LOG_ERR("lte_lc_psm_req, error: %d", err);
  }
  err = lte_lc_edrx_req(true);
  if (err) {
    LOG_ERR("lte_lc_edrx_req, error: %d", err);
  }

	LOG_INF("Connecting to LTE network");
	err = lte_lc_connect_async(lte_handler);
	if (err) {
		LOG_ERR("lte_lc_connect_async failed: %d", err);
		return err;
	}

	k_sem_take(&lte_connected, K_FOREVER);
	LOG_INF("Connected to LTE network");

  LOG_INF("Waiting for time sync...");
  err = k_sem_take(&time_synced, K_SECONDS(30));
  if (err) {
    LOG_ERR("Timed out waiting for time sync");
    return -ETIMEDOUT;
  }
  return 0;
}

static int agnss_request_and_inject(void)
{
  int                                    err;
  struct nrf_modem_gnss_agnss_data_frame req = {0};

  err = k_sem_take(&agnss_req_ready, K_SECONDS(10));

  if (err == 0) {
    LOG_INF("Using modem A-GNSS request: data_flags=0x%08X",
            gnss_agnss_req.data_flags);
    memcpy(&req, &gnss_agnss_req, sizeof(req));
  } else {
    LOG_WRN("EVT_AGNSS_REQ not received, falling back to expiry flags");
    struct nrf_modem_gnss_agnss_expiry expiry = {0};
    err = nrf_modem_gnss_agnss_expiry_get(&expiry);
    if (err) {
      LOG_ERR("Failed to get A-GNSS expiry: %d", err);
      return err;
    }
    if (!req.data_flags) {
      LOG_INF("A-GNSS data still valid, skipping request");
      return 0;
    }
    req.data_flags             = expiry.data_flags;
    req.system_count           = 2;
    req.system[0].system_id    = NRF_MODEM_GNSS_SYSTEM_GPS;
    req.system[0].sv_mask_ephe = 0xFFFFFFFF;
    req.system[0].sv_mask_alm  = 0xFFFFFFFF;
    req.system[1].system_id    = NRF_MODEM_GNSS_SYSTEM_QZSS;
    req.system[1].sv_mask_ephe = 0x3FF;
    req.system[1].sv_mask_alm  = 0x3FF;
  }

  /* Generate JWT for REST authentication */
  err = nrf_cloud_jwt_generate(0, jwt_buf, sizeof(jwt_buf));
  if (err) {
    LOG_ERR("Failed to generate JWT: %d", err);
    return err;
  }

  struct nrf_cloud_rest_context rest_ctx = {
    .connect_socket = -1,
    .keep_alive     = false,
    .timeout_ms     = NRF_CLOUD_REST_TIMEOUT_NONE,
    .auth           = jwt_buf,
    .rx_buf         = rx_buf,
    .rx_buf_len     = sizeof(rx_buf),
    .fragment_size  = 0,
  };

  struct nrf_cloud_rest_agnss_request agnss_req = {
    .type      = NRF_CLOUD_REST_AGNSS_REQ_CUSTOM,
    .agnss_req = &req,
    .net_info  = NULL,
  };

  struct nrf_cloud_rest_agnss_result agnss_result = {
    .buf    = agnss_data_buf,
    .buf_sz = sizeof(agnss_data_buf),
  };

  /* Attach cell info for better satellite filtering */
  err = lte_lc_neighbor_cell_measurement(NULL);
  if (err) {
    LOG_WRN(
      "Cell measurement trigger failed: %d, proceeding without location hint",
      err);
  }
  err = k_sem_take(&cell_meas_ready, K_SECONDS(10));
  if (err) {
    LOG_WRN("Cell measurement timed out, proceeding without location hint");
  } else if (cell_info.current_cell.id == LTE_LC_CELL_EUTRAN_ID_INVALID) {
    LOG_WRN("Cell measurement returned invalid cell ID, proceeding without "
            "location hint");
  } else {
    LOG_INF("Cell info acquired");
  }

  bool has_cell_info =
    (err == 0 && cell_info.current_cell.id != LTE_LC_CELL_EUTRAN_ID_INVALID);

  agnss_req.net_info = has_cell_info ? &cell_info : NULL;

  LOG_INF("Requesting A-GNSS data from nRF Cloud via REST...");
  err = nrf_cloud_rest_agnss_data_get(&rest_ctx, &agnss_req, &agnss_result);
  if (err) {
    LOG_ERR("nrf_cloud_rest_agnss_data_get failed: %d (HTTP status: %d)", err,
            rest_ctx.status);
    return err;
  }

  LOG_INF("Received %zu bytes of A-GNSS data, injecting into modem...",
          agnss_result.agnss_sz);

  err = nrf_cloud_agnss_process(agnss_result.buf, agnss_result.agnss_sz);
  if (err) {
    LOG_ERR("nrf_cloud_agnss_process failed: %d", err);
    return err;
  }

  /* Verify the modem accepted the data */
  struct nrf_modem_gnss_agnss_expiry expiry_after = {0};
  if (nrf_modem_gnss_agnss_expiry_get(&expiry_after) == 0) {
    if (expiry_after.data_flags == 0) {
      LOG_INF("A-GNSS injection verified: modem has valid assistance data");
    } else {
      LOG_WRN("A-GNSS injection incomplete, modem still needs flags=0x%08X",
              expiry_after.data_flags);
    }
  }

  return 0;
}

static int gnss_delete_data(void)
{
  int err;

  uint32_t delete_mask =
    NRF_MODEM_GNSS_DELETE_EPHEMERIDES | NRF_MODEM_GNSS_DELETE_ALMANACS |
    NRF_MODEM_GNSS_DELETE_IONO_CORRECTION_DATA |
    NRF_MODEM_GNSS_DELETE_LAST_GOOD_FIX | NRF_MODEM_GNSS_DELETE_GPS_TOW |
    NRF_MODEM_GNSS_DELETE_GPS_WEEK | NRF_MODEM_GNSS_DELETE_UTC_DATA |
    NRF_MODEM_GNSS_DELETE_GPS_TOW_PRECISION | NRF_MODEM_GNSS_DELETE_EKF;

  err = nrf_modem_gnss_nv_data_delete(delete_mask);
  if (err) {
    LOG_ERR("Failed to delete GNSS data: %d", err);
    return err;
  }
  LOG_INF("GNSS cold start: all stored data deleted");
  return err;
}

static int gnss_init_and_start(void)
{
  int err;

  if (IS_ENABLED(CONFIG_GNSS_COLD_START)) {
    err = gnss_delete_data();
    if (err) {
      return err;
    }
  }

  /* Activate gnss + lte */
  err = lte_lc_func_mode_set(LTE_LC_FUNC_MODE_NORMAL);
  if (err) {
    LOG_ERR("Failed to activate GNSS functional mode, error: %d", err);
    return err;
  }

  err = nrf_modem_gnss_event_handler_set(gnss_event_handler);
  if (err) {
    LOG_ERR("Failed to set GNSS event handler, error: %d", err);
    return err;
  }

  int32_t interval =
    IS_ENABLED(CONFIG_GNSS_SINGLE_FIX) ? 0 : CONFIG_GNSS_PERIODIC_INTERVAL;
  err = nrf_modem_gnss_fix_interval_set(interval);
  if (err) {
    LOG_ERR("Failed to set GNSS fix interval, error: %d", err);
    return err;
  }

  err = nrf_modem_gnss_fix_retry_set(CONFIG_GNSS_PERIODIC_TIMEOUT);
  if (err) {
    LOG_ERR("Failed to set GNSS fix retry, error: %d", err);
    return err;
  }

  LOG_INF("Starting GNSS");
  err = nrf_modem_gnss_start();
  if (err) {
    LOG_ERR("Failed to start GNSS, error: %d", err);
    return err;
  }

  gnss_start_time = k_uptime_get();

  return 0;
}

int main(void)
{
  int err;

  err = modem_configure();
  if (err) {
    LOG_ERR("Failed to configure the modem, error: %d", err);
    return err;
  }

  err = gnss_init_and_start();
  if (err) {
		LOG_ERR("Failed to initialize and start GNSS");
    return err;
  }

  err = agnss_request_and_inject();
  if (err) {
    LOG_WRN("A-GNSS fetch failed (%d), will continue without assistance", err);
  }

  while (1) {
    k_sleep(K_FOREVER);
  }

  return 0;
}
```

## include/fake_agps_data.h
```c
#ifndef FAKE_AGPS_DATA
#define FAKE_AGPS_DATA

#include <nrf_modem_gnss.h>

int agps_fake_inject_all(const struct nrf_modem_gnss_agnss_data_frame *req);

#endif /* !FAKE_AGPS_DATA */
```

## src/fake_agps_data.c
```c
#include <zephyr/kernel.h>
#include <nrf_modem_gnss.h>
#include <zephyr/logging/log.h>

LOG_MODULE_REGISTER(agps_fake, LOG_LEVEL_INF);

/*
 * TOE/TOC: must be within ~2 hours of current GPS time of week.
 * raw = physical_seconds / 16
 * Update FAKE_TOC_TOE if rebuilding more than a few hours later.
 * GPS week 2409, ~223200 s into week (generated March 10 2026 ~15:00 UTC).
 */
#define FAKE_TOC_TOE   13950U      /* 223200 s / 16 */
#define FAKE_SQRT_A    2703380586U /* 5153.7 m^0.5 × 2^19 */
#define FAKE_I0        656019922   /* 55° × (2^31/180°) */
#define FAKE_OMEGA_DOT (-7281)
#define FAKE_DELTA_N   12596

/* UTC (flag 0x01) */
static struct nrf_modem_gnss_agnss_gps_data_utc fake_utc = {
  .a1         = 0,
  .a0         = 0,
  .tot        = 54,
  .wn_t       = 105, /* week 2409 mod 256 = 105 */
  .delta_tls  = 18,
  .wn_lsf     = 105,
  .dn         = 1,
  .delta_tlsf = 18,
};

/* KLOBUCHAR (flag 0x02) */
static struct nrf_modem_gnss_agnss_data_klobuchar fake_klobuchar = {
  .alpha0 = 12,
  .alpha1 = 4,
  .alpha2 = -1,
  .alpha3 = -2,
  .beta0  = 63,
  .beta1  = 10,
  .beta2  = -1,
  .beta3  = -9,
};

/* NEQUICK (flag 0x04)
 *
 * NeQuick is used for Galileo. The modem requests it regardless of whether
 * Galileo SVs are present. Injecting zeroed nominal values satisfies the
 * request without affecting GPS accuracy.
 *
 * struct nrf_modem_gnss_agnss_data_nequick:
 *   int16_t ai0   effective ionisation level 1st order  scale 2^-2   SFU
 *   int16_t ai1   effective ionisation level 2nd order  scale 2^-8   SFU/deg
 *   int16_t ai2   effective ionisation level 3rd order  scale 2^-15  SFU/deg²
 *   uint8_t storm_cond   ionospheric storm condition bitmask (0 = no storm)
 *   uint8_t storm_valid  storm condition valid flag (0 = not valid)
 *
 * Nominal mid-latitude values (quiet ionosphere):
 *   ai0 = 20.0 SFU  → raw = 20.0 / 2^-2  = 80
 *   ai1 = 0.0       → 0
 *   ai2 = 0.0       → 0
 */
static struct nrf_modem_gnss_agnss_data_nequick fake_nequick = {
  .ai0         = 80, /* 20.0 SFU / 2^-2 */
  .ai1         = 0,
  .ai2         = 0,
  .storm_cond  = 0, /* no ionospheric storm */
  .storm_valid = 0, /* storm data not valid */
};

/* GPS SYSTEM TIME + SV TOW (flag 0x08) */
static struct nrf_modem_gnss_agnss_gps_data_system_time_and_sv_tow
  fake_sys_time = {
    .date_day     = 16866, /* days since GPS epoch, approx March 10 2026 */
    .time_full_s  = 54000, /* full seconds of current day */
    .time_frac_ms = 0,     /* fractional milliseconds */
    .sv_mask      = 0,     /* no per-SV TOW data provided */
    /* sv_tow[] zero-initialized — modem ignores entries not set in sv_mask */
};

/* POSITION (flag 0x10) */
static struct nrf_modem_gnss_agnss_data_location fake_location = {
  .latitude  = 4553633, /* 48.8566° N: round(48.8566 × 2^23/90)  */
  .longitude = 109601,  /*  2.3522° E: round( 2.3522 × 2^24/360) */
  .altitude  = 35,      /* 35 m above WGS-84 ellipsoid            */

  /* Horizontal uncertainty: r = 10 × (1.1^K - 1) meters
   * K=26 → r ≈ 109 km  (circular, north-aligned) */
  .unc_semimajor = 26,
  .unc_semiminor = 26,
  .orientation_major =
    0, /* major axis pointing north (irrelevant for circle) */

  /* Altitude uncertainty: h = 45 × (1.025^K - 1) meters
   * 255 = "missing" — safest choice when we don't know altitude precisely */
  .unc_altitude = 255,

  /* Confidence: 68% = standard 1-sigma ellipse */
  .confidence = 68,
};

static struct nrf_modem_gnss_agnss_data_integrity fake_integrity = {
  .signal_count = 1,
  .signal =
    {
      {
        .signal_id      = NRF_MODEM_GNSS_SIGNAL_GPS_L1_CA,
        .integrity_mask = 0x0ULL, /* 0 = all GPS SVs healthy */
      },
    },
};

static struct nrf_modem_gnss_agnss_gps_data_ephemeris fake_ephem[4] = {
  {.sv_id     = 1,
   .health    = 0,
   .iodc      = 0x0001,
   .toc       = FAKE_TOC_TOE,
   .af0       = 0,
   .af1       = 0,
   .af2       = 0,
   .tgd       = 0,
   .ura       = 2,
   .toe       = FAKE_TOC_TOE,
   .w         = 0,
   .delta_n   = FAKE_DELTA_N,
   .m0        = 0,
   .omega_dot = FAKE_OMEGA_DOT,
   .e         = 0,
   .idot      = 0,
   .sqrt_a    = FAKE_SQRT_A,
   .i0        = FAKE_I0,
   .omega0    = 0,
   .crs       = 0,
   .cis       = 0,
   .cus       = 0,
   .crc       = 0,
   .cic       = 0,
   .cuc       = 0},
  {.sv_id     = 2,
   .health    = 0,
   .iodc      = 0x0002,
   .toc       = FAKE_TOC_TOE,
   .af0       = 0,
   .af1       = 0,
   .af2       = 0,
   .tgd       = 0,
   .ura       = 2,
   .toe       = FAKE_TOC_TOE,
   .w         = 0,
   .delta_n   = FAKE_DELTA_N,
   .m0        = 1073741824,
   .omega_dot = FAKE_OMEGA_DOT,
   .e         = 0,
   .idot      = 0,
   .sqrt_a    = FAKE_SQRT_A,
   .i0        = FAKE_I0,
   .omega0    = 715827882,
   .crs       = 0,
   .cis       = 0,
   .cus       = 0,
   .crc       = 0,
   .cic       = 0,
   .cuc       = 0},
  {.sv_id     = 3,
   .health    = 0,
   .iodc      = 0x0003,
   .toc       = FAKE_TOC_TOE,
   .af0       = 0,
   .af1       = 0,
   .af2       = 0,
   .tgd       = 0,
   .ura       = 2,
   .toe       = FAKE_TOC_TOE,
   .w         = 0,
   .delta_n   = FAKE_DELTA_N,
   .m0        = 2147483647,
   .omega_dot = FAKE_OMEGA_DOT,
   .e         = 0,
   .idot      = 0,
   .sqrt_a    = FAKE_SQRT_A,
   .i0        = FAKE_I0,
   .omega0    = 1431655765,
   .crs       = 0,
   .cis       = 0,
   .cus       = 0,
   .crc       = 0,
   .cic       = 0,
   .cuc       = 0},
  {.sv_id     = 4,
   .health    = 0,
   .iodc      = 0x0004,
   .toc       = FAKE_TOC_TOE,
   .af0       = 0,
   .af1       = 0,
   .af2       = 0,
   .tgd       = 0,
   .ura       = 2,
   .toe       = FAKE_TOC_TOE,
   .w         = 0,
   .delta_n   = FAKE_DELTA_N,
   .m0        = -1073741824,
   .omega_dot = FAKE_OMEGA_DOT,
   .e         = 0,
   .idot      = 0,
   .sqrt_a    = FAKE_SQRT_A,
   .i0        = FAKE_I0,
   .omega0    = 2147483647,
   .crs       = 0,
   .cis       = 0,
   .cus       = 0,
   .crc       = 0,
   .cic       = 0,
   .cuc       = 0},
};

static struct nrf_modem_gnss_agnss_gps_data_almanac fake_almanac[4] = {
  {.sv_id     = 1,
   .sv_health = 0,
   .wn        = 105,
   .toa       = 54,
   .ioda      = 0,
   .e         = 0,
   .delta_i   = 2919,
   .omega_dot = -92,
   .sqrt_a    = 10554726U,
   .omega0    = 0,
   .w         = 0,
   .m0        = 0,
   .af0       = 0,
   .af1       = 0},
  {.sv_id     = 2,
   .sv_health = 0,
   .wn        = 105,
   .toa       = 54,
   .ioda      = 0,
   .e         = 0,
   .delta_i   = 2919,
   .omega_dot = -92,
   .sqrt_a    = 10554726U,
   .omega0    = 1398101,
   .w         = 0,
   .m0        = 2097152,
   .af0       = 0,
   .af1       = 0},
  {.sv_id     = 3,
   .sv_health = 0,
   .wn        = 105,
   .toa       = 54,
   .ioda      = 0,
   .e         = 0,
   .delta_i   = 2919,
   .omega_dot = -92,
   .sqrt_a    = 10554726U,
   .omega0    = 2796202,
   .w         = 0,
   .m0        = 4194304,
   .af0       = 0,
   .af1       = 0},
  {.sv_id     = 4,
   .sv_health = 0,
   .wn        = 105,
   .toa       = 54,
   .ioda      = 0,
   .e         = 0,
   .delta_i   = 2919,
   .omega_dot = -92,
   .sqrt_a    = 10554726U,
   .omega0    = 4194304,
   .w         = 0,
   .m0        = -2097152,
   .af0       = 0,
   .af1       = 0},
};

#define INJECT(buf, type, label)                                               \
  do {                                                                         \
    int _r = nrf_modem_gnss_agnss_write(&(buf), sizeof(buf), (type));          \
    if (_r) {                                                                  \
      LOG_ERR(label " failed: %d", _r);                                        \
      return _r;                                                               \
    }                                                                          \
    LOG_INF(label " injected");                                                \
  } while (0)

int agps_fake_inject_all(const struct nrf_modem_gnss_agnss_data_frame *req)
{
  if (req->data_flags & NRF_MODEM_GNSS_AGNSS_GPS_UTC_REQUEST) {
    INJECT(fake_utc, NRF_MODEM_GNSS_AGNSS_GPS_UTC_PARAMETERS, "UTC");
  }
  if (req->data_flags & NRF_MODEM_GNSS_AGNSS_KLOBUCHAR_REQUEST) {
    INJECT(fake_klobuchar,
           NRF_MODEM_GNSS_AGNSS_KLOBUCHAR_IONOSPHERIC_CORRECTION, "Klobuchar");
  }
  if (req->data_flags & NRF_MODEM_GNSS_AGNSS_NEQUICK_REQUEST) {
    INJECT(fake_nequick, NRF_MODEM_GNSS_AGNSS_NEQUICK_IONOSPHERIC_CORRECTION,
           "NeQuick");
  }
  if (req->data_flags & NRF_MODEM_GNSS_AGNSS_GPS_SYS_TIME_AND_SV_TOW_REQUEST) {
    INJECT(fake_sys_time, NRF_MODEM_GNSS_AGNSS_GPS_SYSTEM_CLOCK_AND_TOWS,
           "Sys time");
  }
  if (req->data_flags & NRF_MODEM_GNSS_AGNSS_POSITION_REQUEST) {
    INJECT(fake_location, NRF_MODEM_GNSS_AGNSS_LOCATION, "Position");
  }
  if (req->data_flags & NRF_MODEM_GNSS_AGNSS_INTEGRITY_REQUEST) {
    INJECT(fake_integrity, NRF_MODEM_GNSS_AGNSS_INTEGRITY, "Integrity");
  }

  /* Ephemeris and almanac: iterate over systems requested */
  for (int s = 0; s < req->system_count; s++) {
    const struct nrf_modem_gnss_agnss_system_data_need *sys = &req->system[s];

    /* Only handle GPS */
    if (sys->system_id != NRF_MODEM_GNSS_SYSTEM_GPS) {
      LOG_INF("Skipping system_id %d (not GPS)", sys->system_id);
      continue;
    }

    LOG_INF("GPS ephe mask: 0x%08llX  alm mask: 0x%08llX", sys->sv_mask_ephe,
            sys->sv_mask_alm);

    /* Inject the 4 fakes ephemerides for any SV requested */
    if (sys->sv_mask_ephe) {
      for (int i = 0; i < ARRAY_SIZE(fake_ephem); i++) {
        int r =
          nrf_modem_gnss_agnss_write(&fake_ephem[i], sizeof(fake_ephem[i]),
                                     NRF_MODEM_GNSS_AGNSS_GPS_EPHEMERIDES);
        if (r) {
          LOG_ERR("Ephem SV%d failed: %d", fake_ephem[i].sv_id, r);
          return r;
        }
        LOG_INF("Ephem SV%d injected", fake_ephem[i].sv_id);
      }
    }

    /* Inject the 4 fakes almanacs for any SV requested */
    if (sys->sv_mask_alm) {
      for (int i = 0; i < ARRAY_SIZE(fake_almanac); i++) {
        int r =
          nrf_modem_gnss_agnss_write(&fake_almanac[i], sizeof(fake_almanac[i]),
                                     NRF_MODEM_GNSS_AGNSS_GPS_ALMANAC);
        if (r) {
          LOG_ERR("Alm SV%d failed: %d", fake_almanac[i].sv_id, r);
          return r;
        }
        LOG_INF("Alm SV%d injected", fake_almanac[i].sv_id);
      }
    }
  }

  LOG_INF("A-GNSS injection complete");
  return 0;
}
```
